## sdkconfig.defaults
```kconfig
CONFIG_FREERTOS_USE_TRACE_FACILITY=y
CONFIG_FREERTOS_HZ=1000
#CONFIG_BOOTLOADER_LOG_LEVEL_NONE=n
#CONFIG_LOG_DEFAULT_LEVEL_NONE=y
#CONFIG_ESP_TASK_WDT=y
CONFIG_AUTOSTART_ARDUINO=y
```
